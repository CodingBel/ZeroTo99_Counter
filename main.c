/*
* This Project Counts From 0 upto 99 With a 1 Second Interval
* Generated by Timer0. 
* The Project Flickers on Simmulation but works perfectly (i.e with out
* Flickering on Hardware) 
* The Project Uses An External XTAL of 4MHZ. 
* The Project Uses Two Common-Cathode 7Segment display and 
* Two NPN Transistors For Switching b/n the two 7Segment displays 
*
* Author: ABEL ASHENAFI 
* Date: January 15, 2019 
* belaashu23@gmail.com
*/

#include <p18f4520.h>
#include "prototyper.h"

#pragma config OSC = HS
#pragma config LVP = OFF
#pragma config WDT = OFF

extern volatile unsigned char overflow;


void main (void)
{
	int count = 0;
	
	Port_Init ();
	TMR0_Config ();
	Interrupt_Init ();
							
	while (1)
	{
		DisplayDigit(count);
		
		if (overflow)
		{
			count += 1;
				
			if (count == 100)
			{
				count = 0;
			}
			overflow = 0;				
		}
	}
}

